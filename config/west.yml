## config/west.yml
```yaml
manifest:
  defaults:
    revision: v0.3
  remotes:
    - name: zmkfirmware
      url-base: https://github.com/zmkfirmware
    - name: zmkfirmware_custom
      url-base: https://github.com/alexanderk23
    - name: urob
      url-base: https://github.com/urob
  projects:
    - name: zmk
      remote: zmkfirmware_custom
      import: app/west.yml
      revision: fix-sensor-rotate-behavior
    - name: zmk-helpers
      remote: urob
      revision: main
  self:
    path: config
```
